## sdkconfig.defaults
```kconfig
CONFIG_IDF_TARGET="esp32"

# Run the core at the full 240 MHz. The renderer produces points at POINT_RATE_HZ
# from a flash-resident loop; 160 MHz left it flash-stall bound and underrunning
# the point ring. The board is mains-powered, so there is no reason to clock down.
CONFIG_ESP_DEFAULT_CPU_FREQ_MHZ_240=y

# Laser engine: the gptimer alarm callback is the SPI consumer and must keep
# running even while the flash cache is disabled (e.g. during a flash write), so
# the whole ISR path lives in IRAM and touches no flash.
#   - GPTIMER_ISR_IRAM_SAFE  : place the gptimer ISR in IRAM, cache-safe.
#   - GPTIMER_CTRL_FUNC_IN_IRAM : gptimer_get_raw_count / gptimer_set_alarm_action
#                                 (used inside the callback) become IRAM-safe.
#   - SPI_MASTER_ISR_IN_IRAM : keeps spi_hal_iram.c (the transaction functions
#                              isr_spi calls) mapped into IRAM.
CONFIG_GPTIMER_ISR_IRAM_SAFE=y
CONFIG_GPTIMER_CTRL_FUNC_IN_IRAM=y
CONFIG_SPI_MASTER_ISR_IN_IRAM=y
```
